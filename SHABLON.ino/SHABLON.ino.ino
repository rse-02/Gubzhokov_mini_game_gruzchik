//-слэш - разрез /слэш в гору \слэш с горы
//Маркеры памяти
//void - пустота - космос - ничего - не использует память
//int  - интеджер - целое - память для чисел 12345
//char - символы - буквы
//long - для всего
//------setup - Название{}
//------() - круглые скобки (SHIFT+9, SHIFT+0) настройки
//------{} - фигурные скобки (SHIFT+Х, SHIFT+Ъ) Начало и конец
//Сложных приказов

//-----------настройка модуля реального времени-------
#include <DS1302.h>

// Инициализация модуля DS1302
DS1302 rtc(6, 7, 8); // RST, DAT, CLK
//--------------------------

// способности 
// узнать время с помощью DS1302
void vrem(){
  // Чтение времени с модуля DS1302
  rtc.readTime();
  int hour = rtc.getHour();
  int minute = rtc.getMinute();
  int second = rtc.getSecond();
  // Вывод времени в монитор порта
  Serial.print(hour);
  Serial.print(":");
  Serial.print(minute);
  Serial.print(":");
  Serial.println(second);
  delay(1000);  // Задержка 1 секунду

}// Инициализация модуля DS1302
DS1302 rtc(6, 7, 8); // RST, DAT, CLK

 // Настройка порта времени DS1302
  rtc.halt(false);
  rtc.writeProtect(false);
  // Установка времени
  rtc.setDOW(SATURDAY);  // Установка дня недели
  rtc.setTime(12, 30, 0);  // Установка времени (часы, минуты, секунды)
  rtc.setDate(5, 5, 2023);  // Установка даты (день, месяц, год)
}

int k[5]={0,0,0,0,0}

void knop(int a){
    k[a]=1;
}

void reset(){
  for (int a=1; a<#k; a++){
    k[a]=0;
  }
}


void setup() {  
   int s=0;

}

void loop() {
  //преход Тригеры
    if(s==1){
      // ПОВТОР ОТ А = 1 ДО А = #K (#- РАЗМЕР, K - СПИСОК КНОПОК = 5 )  ПОВТОРИТЬ 5 РАЗ
      //  for (int a=1; a<#k; a++){
          
      // IF ЕСЛИ ПРОВЕРКА КНОПКИ ПОД НОМЕРОМ А - ОТ 1 ДО 5 ЕСЛИ КНОПКА НАЖАТА ТО 
      //    if (k[a]==1){
        if(k[a]==1)}

      //  ИЗМЕНИТЬ СОСТОЯНИЕ НА 2
      //     s=2;
            s=2;
            

      //СБРОИТЬ ПАМЯТЬ Кнопок
      //     reset();

      // закончить повтор елли досрочно
      //     break

      // конец проверки кнопк
      //    }


      // конец повтора
      //  }

    }
  //---------------

  //СОСТОЯНИЕ
     //ждать
    if(s==1){
       
    }
  // игра 
  if(s==2){

    }
  // проиграл 
  if(s==3){

    }

  // выиграл
    if(s==4){
    

    }
  // разряжено
    if(s==5){

  //---------
  
    
}
